## boards/shields/keyboard-hack/Kconfig.defconfig
```kconfig
config GPIO_MCP230XX
    def_bool y

config GPIO_MCP23XXX_INIT_PRIORITY
    int "Init priority"
    default 40

config CONFIG_BT_DEVICE_NAME
    string "BT device name"
    default "Adrian's AK820"
```
